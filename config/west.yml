## config/west.yml
```yaml
manifest:
  remotes:
    - name: zmkfirmware
      url-base: https://github.com/zmkfirmware
    - name: mctechnology17
      url-base: https://github.com/mctechnology17
    - name: urob
      url-base: https://github.com/urob
    - name: kevinpastor
      url-base: https://github.com/kevinpastor
  projects:
    - name: zmk
      remote: zmkfirmware
      revision: main
      import: app/west.yml
    - name: zmk-oled-adapter
      remote: mctechnology17
      revision: main
    - name: zmk-helpers
      remote: urob
      revision: main
    - name: nice-view-elemental
      remote: kevinpastor
      revision: main
  self:
    path: config
```
